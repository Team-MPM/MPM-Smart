## src/micro/esp32/component1/Kconfig
```kconfig
menuconfig COMPONENT1
    bool "Component 1"
    default n
    help
      Enable component 1
```

## src/micro/esp32/component2/Kconfig
```kconfig
menuconfig COMPONENT2
    bool "Component 2"
    default n
    help
      Enable component 2
```
